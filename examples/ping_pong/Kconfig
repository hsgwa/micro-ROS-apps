## examples/ping_pong/Kconfig
```kconfig
config UROS_EXAMPLES_PINGPONG
	bool "microROS PingPong"
	default n
	depends on UROS
	---help---
		Enable the publisher uROS example

if UROS_EXAMPLES_PUBLISHER

config UROS_EXAMPLES_PUBLISHER_PROGNAME
	string "Program name"
	default "ping_pong"
	depends on BUILD_KERNEL
	---help---
		This is the name of the program that will be use when the NSH ELF
		program is installed.

#config UROS_EXAMPLES_PUBLISHER_PRIORITY
#	int "PingPong task priority"
#	default 100
#
#config UROS_EXAMPLES_PUBLISHER_STACKSIZE
#	int "PingPong stack size"
#	default 2048

endif
```

## examples/ucs_distance/Kconfig
```kconfig
config UCS_DISTANC_EXAMPLE
	bool "UCS demo - microROS Distance Publisher over 6LoWPAN"
	default n
	depends on UROS
	---help---
		Enable the uROS distance publisher example over 6LoWPAN radio communication

if UCS_DISTANC_EXAMPLE

config UCS_DISTANC_EXAMPLE_PROGNAME
	string "Program name"
	default "ucs_distance"
	depends on BUILD_KERNEL
	---help---
		This is the name of the program that will be use when the NSH ELF
		program is installed.

endif
```

## examples/ucs_effector/Kconfig
```kconfig
config UCS_EFFECTOR_EXAMPLE
	bool "UCS demo - microROS EFFECTOR Subscriber over 6LoWPAN"
	default n
	depends on UROS
	---help---
		Enable the effector subscriber example over 6LoWPAN radio communication

if UCS_EFFECTOR_EXAMPLE

config UCS_EFFECTOR_EXAMPLE_PROGNAME
	string "Program name"
	default "ucs_effector"
	depends on BUILD_KERNEL
	---help---
		This is the name of the program that will be use when the NSH ELF
		program is installed.

endif
```

## examples/ucs_hih6130/Kconfig
```kconfig
config UCS_HIH6130_EXAMPLE
	bool "UCS demo - microROS HIH6130 Publisher over 6LoWPAN"
	default n
	depends on UROS
	---help---
		Enable the HIH6130 publisher example over 6LoWPAN radio communication

if UCS_HIH6130_EXAMPLE

config UCS_HIH6130_EXAMPLE_PROGNAME
	string "Program name"
	default "ucs_hih6130"
	depends on BUILD_KERNEL
	---help---
		This is the name of the program that will be use when the NSH ELF
		program is installed.

endif
```

## examples/ucs_opener/Kconfig
```kconfig
config UCS_OPENER_EXAMPLE
	bool "UCS demo - microROS OPENER Subcriber over 6LoWPAN"
	default n
	depends on UROS
	---help---
		Enable the opener example over 6LoWPAN radio communication

if UCS_OPENER_EXAMPLE

config UCS_OPENER_EXAMPLE_PROGNAME
	string "Program name"
	default "ucs_opener"
	depends on BUILD_KERNEL
	---help---
		This is the name of the program that will be use when the NSH ELF
		program is installed.


endif
```
